## firmware/components/desk_can/Kconfig
```kconfig
menu "Desk CAN link"

config DESK_CAN_ENABLE
    bool "Send readings and heartbeat over CAN (TWAI)"
    default n
    help
        Sends one DeskNode frame per wake cycle on a CAN bus through an external
        3.3 V CAN transceiver. The frame layout is can_monitor/desk_node.dbc.

config DESK_CAN_TX_GPIO
    int "TWAI TX GPIO (to transceiver TXD)"
    default 19
    range 0 39
    depends on DESK_CAN_ENABLE

config DESK_CAN_RX_GPIO
    int "TWAI RX GPIO (from transceiver RXD)"
    default 4
    range 0 39
    depends on DESK_CAN_ENABLE

endmenu
```

## firmware/main/Kconfig.projbuild
```kconfig
menu "LifeOS Desk Node"
    choice DESK_DISPLAY_INTERFACE
        prompt "SSD1306 display interface"
        default DESK_DISPLAY_SPI
        config DESK_DISPLAY_SPI
            bool "4-wire SPI module (revision 2 J4)"
        config DESK_DISPLAY_I2C
            bool "Legacy I2C module (revision 1 / J2)"
    endchoice
    config DESK_WIFI_SSID
        string "Wi-Fi SSID"
        default ""
    config DESK_WIFI_PASSWORD
        string "Wi-Fi password (local build only)"
        default ""
    config DESK_API_URL
        string "Desk API origin (HTTPS; no trailing slash)"
        default "https://desk.example.invalid"
    config DESK_API_TOKEN
        string "Desk API device token (local build only)"
        default ""
    config DESK_ALLOW_HTTP
        bool "Allow unencrypted HTTP for isolated development"
        default n
    config DESK_UPDATE_SECONDS
        int "Deep sleep interval in seconds"
        range 60 86400
        default 300
    config DESK_WIFI_TIMEOUT_SECONDS
        int "Wi-Fi connection deadline"
        range 5 60
        default 15
    config DESK_SNTP_SERVER
        string "SNTP server"
        default "pool.ntp.org"
    config DESK_BLE_ENABLE
        bool "Advertise temperature and humidity over Bluetooth Low Energy"
        default n
        help
            Adds the standard Environmental Sensing service (0x181A) through NimBLE.
            Use together with sdkconfig.ble.defaults, which turns on the Bluetooth stack.
    config DESK_BLE_WINDOW_SECONDS
        int "BLE window after each wake (seconds)"
        depends on DESK_BLE_ENABLE
        range 10 120
        default 30
        help
            How long the node advertises after each wake. Sensor reads run during this
            window, so the node stays awake this much longer per cycle.
endmenu
```

## linux_sensor/buildroot/package/desk-sensor/Config.in
```kconfig
config BR2_PACKAGE_DESK_SENSOR
 bool "desk-sensor"
 depends on BR2_LINUX_KERNEL
 depends on BR2_INSTALL_LIBSTDCPP
 help
   Virtual I2C adapter, checked sensor driver and C++ diagnostic service.
```
